/*
 * MeshNetwork.cpp
 *
 *  Created on: 24 Jan 2019
 *      Author: mark
 */
#include "MeshNetworkHandler.hpp"

#include "freertos/FreeRTOS.h"
#include "freertos/task.h"
#include "freertos/queue.h"
#include "esp_system.h"
#include "esp_log.h"
#include "driver/uart.h"
#include "soc/uart_struct.h"
#include <string.h>
#include <stdlib.h>

#include "Messaging.h"

/*
 * ----------------------------------------------------------------------------
 *
 *                      Constructors and destructors.
 *
 * ----------------------------------------------------------------------------
 */

/*
 *      Default constructor for the mesh network.
 */
MeshNetworkRequestHandler::MeshNetworkRequestHandler()
{
    if (_instantiated)
    {
        //  TODO: Error condition, "there can be only one..."
    }
    else
    {
        _instantiated = true;
    }
}

/*
 *      Default destructor for the mesh network class.
 */
MeshNetworkRequestHandler::~MeshNetworkRequestHandler()
{
}

/*
 * ----------------------------------------------------------------------------
 *
 *                               Methods
 *
 * ----------------------------------------------------------------------------
 */

/*
 *      Setup the mesh network.
 */
void MeshNetworkRequestHandler::Setup()
{
    const size_t messageSize = sizeof(ApplicationRequest);
    QueueHandle_t queueHandle = xQueueCreate(MAX_QUEUE_LENGTH, messageSize);
    if (queueHandle == NULL)
    {
        ESP_LOGI(_taskName, "Cannot allocate Mesh network queue.");
    }
    SetQueueHandle(queueHandle);
    TaskHandle_t taskHandle;
    xTaskCreate(Task, _taskName, 1024 * 2, this, configMAX_PRIORITIES - 1, &taskHandle);
    SetTaskHandle(taskHandle);
}

/*
 *      Dispatch the message
 */
void MeshNetworkRequestHandler::DispatchRequest(ApplicationRequest *request)
{
    ESP_LOGI(_taskName, "Message handling not implemented, message will be deleted");
    //
    //  Memory for the payload is allocated on the heap and it needs to be released.
    //
    if(request->_payload != NULL)
    {
        ESP_LOG_BUFFER_HEXDUMP(_taskName, request->_payload, request->_payloadLength, ESP_LOG_INFO);
        vPortFree(request->_payload);
    }
}

/*
 *      Process any messages for the Mesh Network.
 *
 *      The messages will be generated by the incoming UART task.
 *
 *      @param pvParameters
 *          Pointer to the instance of the Mesh Network object making the call.
 */
void MeshNetworkRequestHandler::Task(void *pvParameters)
{
    MeshNetworkRequestHandler *sender = (MeshNetworkRequestHandler *) pvParameters;
    while (true)
    {
        ApplicationRequest request;
        BaseType_t result = xQueueReceive(sender->GetQueueHandle(), &request, portMAX_DELAY);
        if (result == pdTRUE)
        {
            sender->DispatchRequest(&request);
        }
    }
    //
    //  We should only get here if the code in the while loop generates a fault.
    //  The documentation for FreeRTOS states that we should delete the task
    //  should we get here.
    //
    vTaskDelete(sender->GetTaskHandle());
}
