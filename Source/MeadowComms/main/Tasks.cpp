/*
 *      Tasks.cpp
 *
 *      Create the tasks for the RTOS.
 */

#include <string>
#include "freertos/FreeRTOS.h"
#include "freertos/task.h"
#include "freertos/queue.h"
#include "driver/uart.h"
#include "soc/uart_struct.h"
#include "esp_log.h"

#include "Tasks.hpp"
#include "WiFi.hpp"
#include  "Messaging.h"
#include "UART.hpp"
#include "Bluetooth.hpp"
#include "MeshNetwork.hpp"

/*
 *      Handle for the WiFi task.
 */
TaskHandle_t xWiFiTaskHandle = NULL;

/*
 *      Name of the WiFi Task.
 */
const char *WIFI_TASK_NAME = const_cast<const char *> ("WiFiTask");

/*
 *      Process any messages for the Bluetooth controller.
 *
 *      The messages will be generated by the incoming UART task.
 *
 *      @param pvParameters
 *          Pointer to a list of parameters passed to the Bluetooth task.
 */
void BluetoothTask(void *pvParameters)
{
    while (true)
    {
        struct ApplicationRequest message;
        QueueHandle_t bluetoothQueueHandle = bluetooth->GetQueueHandle();
        BaseType_t result = xQueueReceive(bluetoothQueueHandle, &message, portMAX_DELAY);
        if (result == pdTRUE)
        {
            ESP_LOGI(bluetooth->GetTaskName(), "Message handling not implemented, message will be deleted");
            //
            //  Memory for the payload is allocated on the heap and it needs to be released.
            //
            if(message._payload != NULL)
            {
                ESP_LOG_BUFFER_HEXDUMP(bluetooth->GetTaskName(), message._payload, message._payloadLength, ESP_LOG_INFO);
                vPortFree(message._payload);
            }
        }
    }
    //
    //  We should only get here if the code in the while loop generates a fault.
    //  The documentation for FreeRTOS states that we should delete the task
    //  should we get here.
    //
    TaskHandle_t taskHandle = bluetooth->GetTaskHandle();
    vTaskDelete(taskHandle);
}

/*
 *      Process any messages for the Mesh Network.
 *
 *      The messages will be generated by the incoming UART task.
 *
 *      @param pvParameters
 *          Pointer to a list of parameters passed to the Mesh Network task.
 */
void MeshNetworkTask(void *pvParameters)
{
    while (true)
    {
        struct ApplicationRequest message;
        QueueHandle_t meshNetworkQueueHandle = meshNetwork->GetQueueHandle();
        BaseType_t result = xQueueReceive(meshNetworkQueueHandle, &message, portMAX_DELAY);
        if (result == pdTRUE)
        {
            ESP_LOGI(meshNetwork->GetTaskName(), "Message handling not implemented, message will be deleted");
            //
            //  Memory for the payload is allocated on the heap and it needs to be released.
            //
            if(message._payload != NULL)
            {
                ESP_LOG_BUFFER_HEXDUMP(meshNetwork->GetTaskName(), message._payload, message._payloadLength, ESP_LOG_INFO);
                vPortFree(message._payload);
            }
        }
    }
    //
    //  We should only get here if the code in the while loop generates a fault.
    //  The documentation for FreeRTOS states that we should delete the task
    //  should we get here.
    //
    vTaskDelete(meshNetwork->GetTaskHandle());
}

/*
 *      Process WiFi message sent through the WiFi queue.
 *
 *      The messages will be generated by the incoming UART task.
 *
 *      @param pvParameters
 *          Pointer to a list of parameters passed to the WiFi task.
 */
void WiFiTask(void *pvParameters)
{
    struct ApplicationRequest message;
    QueueHandle_t wifiQueueHandle = wifi->GetQueueHandle();
    while (true)
    {
        BaseType_t result = xQueueReceive(wifiQueueHandle, &message, portMAX_DELAY);
        if (result == pdTRUE)
        {
            wifi->DispatchRequest(&message);
        }
    }
    //
    //  We should only get here if the code in the while loop generates a fault.
    //  The documentation for FreeRTOS states that we should delete the task
    //  should we get here.
    //
    vTaskDelete(xWiFiTaskHandle);
}

/*
 *      Process the UART transmit messages received through the UART Tx queue.
 *
 *      @param pvParameters
 *          Pointer to a list of parameters passed to the UART Tx task.
 */
void UARTTxTask(void *pvParameters)
{
    QueueHandle_t txQueueHandle = uart->GetUartTransmitQueueHandle();
    TaskHandle_t txTaskHandle = uart->GetUartTransmitTaskHandle();
    while (true)
    {
        ApplicationResponse message;

        BaseType_t result = xQueueReceive(txQueueHandle, &message, portMAX_DELAY);
        if (result == pdTRUE)
        {
            uart->Send(&message);
        }
    }
    //
    //  We should only get here if the code in the while loop generates a fault.
    //  The documentation for FreeRTOS states that we should delete the task
    //  should we get here.
    //
    vTaskDelete(txTaskHandle);
}

/*
 *      Process data received data from the UART interrupt task through the UART Rx queue.
 *
 *      @param pvParameters
 *          Pointer to a list of parameters passed to the UART Rx task.
 */
void UARTRxTask(void *pvParameters)
{
    uart_event_t event;
    QueueHandle_t uartRxQueueHandle = uart->GetUartRxQueueHandle();
    QueueHandle_t uartTxQueueHandle = uart->GetUartTransmitQueueHandle();
    uint8_t* data = (uint8_t *) pvPortMalloc(UART::RX_BUFFER_SIZE);

    while (true)
    {
        int dataLeftToRead = 0;
        int amountToRead = 0;
        if (xQueueReceive(uartRxQueueHandle, (void *) &event, portMAX_DELAY))
        {
            memset(data, 0, UART::RX_BUFFER_SIZE);
            switch (event.type)
            {
                case UART_DATA:
                    dataLeftToRead = event.size;
                    while (dataLeftToRead > 0)
                    {
                        amountToRead = dataLeftToRead <= UART::RX_BUFFER_SIZE ? dataLeftToRead : UART::RX_BUFFER_SIZE;
                        memset(data, 0, UART::RX_BUFFER_SIZE);
                        uart_read_bytes(uart->STM32_UART_PORT_NUMBER, data, amountToRead, portMAX_DELAY);
                        uart->DecodeSerialData(data, amountToRead);
                        dataLeftToRead -= amountToRead;
                    }
                    break;
                case UART_BUFFER_FULL:
                case UART_FIFO_OVF:
                    //
                    //  Flush the input buffer in the case of a full ring buffer or a FIFO overflow.
                    //
                    uart_flush_input(uart->STM32_UART_PORT_NUMBER);
                    xQueueReset(uartRxQueueHandle);
                    break;
                default:
                    uart_flush_input(uart->STM32_UART_PORT_NUMBER);
                    xQueueReset(uartRxQueueHandle);
                    xQueueReset(uartTxQueueHandle);
                    break;
            }
        }
    }
    //
    //  We should only get here if the code in the while loop generates a fault.
    //  The documentation for FreeRTOS states that we should delete the task
    //  should we get here.
    //
    free(data);
    data = NULL;
    uart->RxCleanup();
    vTaskDelete(uart->GetUartReceiveTaskHandle());
    //uart->SetUartReceiveTaskHandle(NULL);
}
