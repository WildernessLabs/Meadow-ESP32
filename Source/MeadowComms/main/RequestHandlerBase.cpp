/*
 *  RequestHandlerBase.cpp
 *
 *  Base class for the request handlers.
 */

#include "freertos/FreeRTOS.h"
#include "freertos/task.h"
#include "freertos/queue.h"
#include "esp_log.h"

#include "Encoders.hpp"
#include "RequestHandlerBase.hpp"

/*
 * ---------------------------------------------------------------------------
 *
 *                     Constructors and destructor
 *
 * ---------------------------------------------------------------------------
 */

/**
 *  Constructor for the RequestHandlerBase class.
 */
RequestHandlerBase::RequestHandlerBase() : _queueHandle(nullptr), _taskHandle(nullptr)
{
}

/**
 *  Create a new request handler object and ensure that
 *  the message dispatcher reference is set up correctly.
 *
 *  @param messageDispatcher
 *      Message dispatcher object that will allow communication
 *      with the STM32.
 */
RequestHandlerBase::RequestHandlerBase(MessageDispatcher *messageDispatcher) : RequestHandlerBase()
{
    _messageDispatcher = messageDispatcher;
}

/**
 *  Destructor for the RequestHandlerBase class.
 */
RequestHandlerBase::~RequestHandlerBase()
{
}

/*
 * ----------------------------------------------------------------------------
 *
 *                      Getters and setters
 *
 * ----------------------------------------------------------------------------
 */

/* ---------------------------------------------------------------------------
 *
 *                              Methods
 *
 * ---------------------------------------------------------------------------
 */

/**
 *  Setup the request handler.
 */
void RequestHandlerBase::Setup()
{
    _queueHandle = xQueueCreate(MAX_QUEUE_LENGTH, sizeof(Message *));
    if (_queueHandle == NULL)
    {
        ESP_LOGE(__func__, "Cannot allocate ESP32 handler queue.");
    }
}

/**
 *  Process any messages for the controller.
 *
 *  The messages will be generated by the incoming UART task.
 *
 *  @param pvParameters
 *      Pointer to the instance of the request handler receiving the
 *      messages for dispatch through the instance specific handler.
 */
void RequestHandlerBase::Task(void *pvParameters)
{
    RequestHandlerBase *sender = (RequestHandlerBase *) pvParameters;
    while (true)
    {
        Message *message;
        BaseType_t result = xQueueReceive(sender->_queueHandle, &message, portMAX_DELAY);
        if (result == pdTRUE)
        {
            sender->DispatchRequest(message);
        }
    }
    //
    //  We should only get here if the code in the while loop generates a fault.
    //  The documentation for FreeRTOS states that we should delete the task
    //  should we get here.
    //
    vTaskDelete(sender->_taskHandle);
}

/**
 *  Add an incoming message to the queue of messages waiting to be processed.
 *
 *  @param message
 *      Message from the STM32 that needs to be queued.
 *
 *  @return
 *      true if the message could be queued, false if there was a problem.
 */
bool RequestHandlerBase::QueueEsp32Message(Message *message)
{
    bool result = true;
    if (xQueueSendToBack(_queueHandle, &message, 0) != pdPASS)
    {
        if (message->Payload != NULL)
        {
            vPortFree(message->Payload);
        }
        vPortFree(message);
        result = false;
    }

    return(result);
}
